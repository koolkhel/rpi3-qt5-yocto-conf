## conf/bblayers.conf
```bitbake
# POKY_BBLAYERS_CONF_VERSION is increased each time build/conf/bblayers.conf
# changes incompatibly
POKY_BBLAYERS_CONF_VERSION = "2"

BBPATH = "${TOPDIR}"
BBFILES ?= ""

DIR="/var/lib/yocto/"
BBLAYERS ?= " \
    ${DIR}/poky-morty/meta \
    ${DIR}/poky-morty/meta-poky \
    ${DIR}/poky-morty/meta-openembedded/meta-oe \
    ${DIR}/poky-morty/meta-openembedded/meta-multimedia \
    ${DIR}/poky-morty/meta-openembedded/meta-networking \
    ${DIR}/poky-morty/meta-openembedded/meta-python \
    ${DIR}/poky-morty/meta-qt5 \
    ${DIR}/poky-morty/meta-raspberrypi \
    ${DIR}/poky-morty/meta-rpi \
  "
```
